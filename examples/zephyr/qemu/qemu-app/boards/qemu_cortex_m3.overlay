/*
    Reserve a special region of RAM for saving Memfault noinit data.
*/
/ {
    sram0: memory@20000000 {
        compatible = "mmio-sram";
        // unfortunately these operators are unsupported for memory units
        // reg = <0x20000000 (DT_SIZE_K(63) - 0x100)>;
        reg = <0x20000000 0xff00>;
    };

    memfaultnoinit: memfaultnoinit@2000ff00 {
        compatible = "zephyr,memory-region";
        reg = <0x2000ff00 0x100>;
        zephyr,memory-region = "MEMFAULTNOINIT";
    };
};
